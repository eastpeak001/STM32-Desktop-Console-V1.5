#include "oled.h"
#include "i2c.h"
#include <string.h>

#define OLED_CMD          0x00
#define OLED_DATA         0x40
#define OLED_PAGES        (OLED_HEIGHT / 8)

static uint8_t OLED_Buffer[OLED_WIDTH * OLED_PAGES];

static const uint8_t Font5x7[][5] = {
  {0x00,0x00,0x00,0x00,0x00}, /*   */
  {0x00,0x00,0x5F,0x00,0x00}, /* ! */
  {0x00,0x07,0x00,0x07,0x00}, /* " */
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  {0x08,0x08,0x2A,0x1C,0x08}  /* ~ */
};

static void OLED_WriteCommand(uint8_t command)
{
  uint8_t data[2] = {OLED_CMD, command};
  HAL_I2C_Master_Transmit(&hi2c1, OLED_I2C_ADDR, data, sizeof(data), HAL_MAX_DELAY);
}

static void OLED_DrawChar(uint8_t x, uint8_t y, char ch)
{
  uint8_t page;
  uint16_t index;
  const uint8_t *glyph;

  if ((x > OLED_WIDTH - 6U) || (y > OLED_HEIGHT - 8U)) {
    return;
  }

  if ((ch < ' ') || (ch > '~')) {
    ch = '?';
  }

  page = y / 8U;
  index = (uint16_t)page * OLED_WIDTH + x;
  glyph = Font5x7[ch - ' '];

  for (uint8_t i = 0; i < 5U; i++) {
    OLED_Buffer[index + i] = glyph[i];
  }
  OLED_Buffer[index + 5U] = 0x00;
}

void OLED_Init(void)
{
  HAL_Delay(100);

  OLED_WriteCommand(0xAE);
  OLED_WriteCommand(0x20);
  OLED_WriteCommand(0x00);
  OLED_WriteCommand(0xB0);
  OLED_WriteCommand(0xC8);
  OLED_WriteCommand(0x00);
  OLED_WriteCommand(0x10);
  OLED_WriteCommand(0x40);
  OLED_WriteCommand(0x81);
  OLED_WriteCommand(0x7F);
  OLED_WriteCommand(0xA1);
  OLED_WriteCommand(0xA6);
  OLED_WriteCommand(0xA8);
  OLED_WriteCommand(0x3F);
  OLED_WriteCommand(0xA4);
  OLED_WriteCommand(0xD3);
  OLED_WriteCommand(0x00);
  OLED_WriteCommand(0xD5);
  OLED_WriteCommand(0x80);
  OLED_WriteCommand(0xD9);
  OLED_WriteCommand(0xF1);
  OLED_WriteCommand(0xDA);
  OLED_WriteCommand(0x12);
  OLED_WriteCommand(0xDB);
  OLED_WriteCommand(0x40);
  OLED_WriteCommand(0x8D);
  OLED_WriteCommand(0x14);
  OLED_WriteCommand(0xAF);

  OLED_Clear();
  OLED_UpdateScreen();
}

void OLED_Clear(void)
{
  memset(OLED_Buffer, 0x00, sizeof(OLED_Buffer));
}

void OLED_ShowString(uint8_t x, uint8_t y, const char *str)
{
  while (*str != '\0') {
    OLED_DrawChar(x, y, *str);
    x += 6U;

    if (x > OLED_WIDTH - 6U) {
      x = 0U;
      y += 8U;
    }

    if (y > OLED_HEIGHT - 8U) {
      break;
    }

    str++;
  }
}

void OLED_UpdateScreen(void)
{
  uint8_t data[OLED_WIDTH + 1U];

  data[0] = OLED_DATA;

  for (uint8_t page = 0; page < OLED_PAGES; page++) {
    OLED_WriteCommand(0xB0 + page);
    OLED_WriteCommand(0x00);
    OLED_WriteCommand(0x10);

    memcpy(&data[1], &OLED_Buffer[OLED_WIDTH * page], OLED_WIDTH);
    HAL_I2C_Master_Transmit(&hi2c1, OLED_I2C_ADDR, data, sizeof(data), HAL_MAX_DELAY);
  }
}
